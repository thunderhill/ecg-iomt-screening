/*
 * ESP32 + AD8232 ECG logger (research prototype).
 *
 * Architecture
 *   sampler task (core 1, periodic)  --> bounded FreeRTOS queue of batches -->
 *   network task (core 0, WebSocket) --> laptop server (docs/protocol.md)
 *
 * The sampler never blocks on the network. When the queue is full, the batch
 * is dropped and counted, so the sampling clock never stalls.
 *
 * Transport: WebSocket over TLS (wss://). The gateway certificate is verified
 * against the project CA in ca_cert.h, and the device authenticates with its
 * token in the upgrade request (see docs/security.md).
 *
 * Target: arduino-esp32 core 3.x, WebSocketsClient library (Links2004).
 * STATUS: this firmware has NOT been compiled for the ESP32 or flashed in this
 *   repository (only syntax-checked with g++ against stub headers).
 *   Verify the timing numbers and ADC behaviour on your board before any use.
 *
 * SAFETY: this device connects to a person. Power it from a battery or an
 * isolated supply, never from mains-connected equipment. See docs/safety.md.
 */

#include <WiFi.h>
#include <WebSocketsClient.h>
#include <time.h>
#include "config.h"
#include "ca_cert.h"   // generated by scripts/security_setup.py init

// ---------- shared state ----------

struct Batch {
  uint32_t seq;
  uint32_t t_us;        // micros() of the first sample in the batch
  uint16_t samples[BATCH_SIZE];
  uint8_t  lo_plus;
  uint8_t  lo_minus;
};

static QueueHandle_t batchQueue = nullptr;
static volatile uint32_t droppedBatches = 0;
static volatile uint32_t achievedSampleCount = 0;
static volatile uint32_t achievedRateHz100 = 0;  // achieved rate x100, updated once per second
static volatile uint32_t lastSentSeq = 0;        // reused by keep-alives; they do not consume sequence numbers

static WebSocketsClient ws;
static bool wsConnected = false;
static uint32_t reconnectDelayMs = 1000;         // exponential backoff: 1 s .. 30 s
static uint32_t lastReconnectAttempt = 0;
static uint32_t lastSendMs = 0;

// ---------- sampler ----------

static void samplerTask(void *arg) {
  (void)arg;
  const TickType_t period = pdMS_TO_TICKS(1000 / SAMPLE_RATE_HZ);
  TickType_t lastWake = xTaskGetTickCount();
  Batch current;
  uint8_t fill = 0;
  uint32_t seq = 0;
  uint32_t rateWindowStart = micros();
  uint32_t rateSamples = 0;

  for (;;) {
    vTaskDelayUntil(&lastWake, period);
    if (fill == 0) {
      current.t_us = micros();
      current.lo_plus = digitalRead(LO_PLUS_PIN);
      current.lo_minus = digitalRead(LO_MINUS_PIN);
    }
    current.samples[fill++] = analogRead(ADC_PIN);  // 12-bit, 0..4095
    rateSamples++;

    if (fill == BATCH_SIZE) {
      current.seq = seq++;
      if (xQueueSend(batchQueue, &current, 0) != pdTRUE) {
        droppedBatches++;  // queue full: count the loss, never block the sampler
      }
      fill = 0;
    }

    uint32_t now = micros();
    if (now - rateWindowStart >= 1000000UL) {
      achievedSampleCount = rateSamples;
      achievedRateHz100 = (uint32_t)((uint64_t)rateSamples * 100000000ULL / (now - rateWindowStart) / 100);
      rateSamples = 0;
      rateWindowStart = now;
    }
  }
}

// ---------- network ----------

static void sendHello() {
  char msg[256];
  snprintf(msg, sizeof(msg),
           "{\"v\":1,\"type\":\"hello\",\"device_id\":\"%s\",\"firmware\":\"%s\","
           "\"simulated\":false,\"fs\":%d,\"batch_size\":%d}",
           DEVICE_ID, FIRMWARE_VERSION, SAMPLE_RATE_HZ, BATCH_SIZE);
  ws.sendTXT(msg);
}

static void sendBatch(const Batch &b) {
  // Built into a fixed buffer: no heap allocation in the send path.
  static char msg[700];
  int n = snprintf(msg, sizeof(msg),
                   "{\"v\":1,\"type\":\"samples\",\"device_id\":\"%s\",\"seq\":%lu,\"t_us\":%lu,"
                   "\"fs\":%d,\"lo_plus\":%s,\"lo_minus\":%s,\"samples\":[",
                   DEVICE_ID, (unsigned long)b.seq, (unsigned long)b.t_us, SAMPLE_RATE_HZ,
                   b.lo_plus ? "true" : "false", b.lo_minus ? "true" : "false");
  for (int i = 0; i < BATCH_SIZE && n < (int)sizeof(msg) - 16; i++) {
    n += snprintf(msg + n, sizeof(msg) - n, i ? ",%u" : "%u", b.samples[i]);
  }
  snprintf(msg + n, sizeof(msg) - n, "]}");
  lastSentSeq = b.seq;
  ws.sendTXT(msg);
  lastSendMs = millis();
}

static void onWsEvent(WStype_t type, uint8_t *payload, size_t length) {
  switch (type) {
    case WStype_CONNECTED:
      wsConnected = true;
      reconnectDelayMs = 1000;  // reset backoff on success
      sendHello();
      Serial.println("ws: connected");
      break;
    case WStype_DISCONNECTED:
      wsConnected = false;
      Serial.println("ws: disconnected");
      break;
    case WStype_TEXT:
      // An ack, or an error with a reason (e.g. "unauthorized") before the server closes.
      Serial.printf("ws: server says %.*s\n", (int)length, (const char *)payload);
      break;
    default:
      break;
  }
}

// TLS rejects certificates outside their validity dates, so the clock must be set first.
static bool clockSet = false;

static void ensureClock() {
  if (clockSet) return;
  configTime(0, 0, NTP_SERVER);
  uint32_t start = millis();
  while (time(nullptr) < 1700000000 && millis() - start < 10000) {
    delay(200);
  }
  clockSet = time(nullptr) >= 1700000000;
  Serial.println(clockSet ? "time: synced" : "time: NOT synced (TLS will fail; check NTP_SERVER)");
}

static void ensureWifi() {
  if (WiFi.status() == WL_CONNECTED) return;
  Serial.println("wifi: connecting");
  WiFi.begin(WIFI_SSID, WIFI_PASSWORD);
  uint32_t start = millis();
  while (WiFi.status() != WL_CONNECTED && millis() - start < 10000) {
    delay(200);
  }
}

static void networkStep() {
  ensureWifi();
  if (WiFi.status() != WL_CONNECTED) return;
  ensureClock();
  if (!clockSet) return;
  ws.loop();
  if (!wsConnected && millis() - lastReconnectAttempt > reconnectDelayMs) {
    lastReconnectAttempt = millis();
    ws.setExtraHeaders("Authorization: Bearer " DEVICE_TOKEN);
    ws.beginSslWithCA(SERVER_HOST, SERVER_PORT, SERVER_PATH, CA_CERT_PEM);
    reconnectDelayMs = min<uint32_t>(reconnectDelayMs * 2, 30000);  // backoff to 30 s
  }
}

// ---------- Arduino entry points ----------

void setup() {
  Serial.begin(115200);
  pinMode(LO_PLUS_PIN, INPUT);
  pinMode(LO_MINUS_PIN, INPUT);
  pinMode(SDN_PIN, OUTPUT);
  digitalWrite(SDN_PIN, HIGH);  // AD8232 active
  analogReadResolution(12);
  analogSetPinAttenuation(ADC_PIN, ADC_11db);  // full ~0..3.3 V range

  batchQueue = xQueueCreate(QUEUE_DEPTH, sizeof(Batch));
  ws.onEvent(onWsEvent);
  xTaskCreatePinnedToCore(samplerTask, "sampler", 4096, nullptr, 5, nullptr, 1);
}

void loop() {
  networkStep();

  // Drain queued batches; send at most a few per pass to keep the loop responsive.
  Batch b;
  for (int i = 0; i < 4 && wsConnected && xQueueReceive(batchQueue, &b, 0) == pdTRUE; i++) {
    sendBatch(b);
  }

  // Diagnostics once per 5 s.
  static uint32_t lastDiag = 0;
  if (millis() - lastDiag > 5000) {
    lastDiag = millis();
    Serial.printf("diag: rate=%lu.%02lu Hz dropped=%lu queued=%u wifi=%d ws=%d\n",
                  (unsigned long)(achievedRateHz100 / 100), (unsigned long)(achievedRateHz100 % 100),
                  (unsigned long)droppedBatches, (unsigned)uxQueueMessagesWaiting(batchQueue),
                  WiFi.status() == WL_CONNECTED, wsConnected);
  }

  // Keep-alive: an empty samples packet tells the server the device is still there.
  if (wsConnected && millis() - lastSendMs > KEEPALIVE_MS) {
    // Empty samples: the server treats this as liveness only (see docs/protocol.md).
    char msg[160];
    snprintf(msg, sizeof(msg),
             "{\"v\":1,\"type\":\"samples\",\"device_id\":\"%s\",\"seq\":%lu,\"t_us\":0,"
             "\"fs\":%d,\"lo_plus\":false,\"lo_minus\":false,\"samples\":[]}",
             DEVICE_ID, (unsigned long)lastSentSeq, SAMPLE_RATE_HZ);
    ws.sendTXT(msg);
    lastSendMs = millis();
  }
  delay(1);
}
